## toolchain/gcc/Config.in
```kconfig
# Choose gcc version.

choice
	prompt "GCC compiler Version" if TOOLCHAINOPTS
	default GCC_USE_VERSION_5_4_0
	help
	  Select the version of gcc you wish to use.

	config GCC_USE_VERSION_5_4_0
		select GCC_VERSION_5_4_0
		bool "gcc 5.4.0"

	config GCC_USE_VERSION_5_5_0
		select GCC_VERSION_5_5_0
		bool "gcc 5.5.0"

	config GCC_USE_VERSION_6_3_0
		select GCC_VERSION_6_3_0
		bool "gcc 6.3.0"

	config GCC_USE_VERSION_6_4_0
		select GCC_VERSION_6_4_0
		bool "gcc 6.4.0"

	config GCC_USE_VERSION_7_2_0
		select GCC_VERSION_7_2_0
		bool "gcc 7.2.0"

endchoice

config GCC_USE_GRAPHITE
	bool
	prompt "Compile in support for the new Graphite framework in GCC 4.4+" if TOOLCHAINOPTS

config EXTRA_GCC_CONFIG_OPTIONS
	string
	prompt "Additional gcc configure options" if TOOLCHAINOPTS
	default ""
	help
	    Any additional gcc options you may want to include....

config SSP_SUPPORT
	bool
	prompt "Enable Stack-Smashing Protection support" if TOOLCHAINOPTS
	default y
	help
	    Enable Stack-Smashing Protection support

config SJLJ_EXCEPTIONS
	bool
	prompt "Use setjump()/longjump() exceptions" if TOOLCHAINOPTS
	default n
	help
	    Use old setjump()/longjump() exceptions instead of the newer
	    frame unwinding exceptions handling routines.  Warning: increases
	    code size and runtime memory usage.

config INSTALL_GFORTRAN
	bool
	prompt "Build/install fortran compiler?" if TOOLCHAINOPTS
	default n
	help
	    Build/install GNU fortran compiler ?

config INSTALL_GCCGO
	bool
	prompt "Build/install Go compiler?" if TOOLCHAINOPTS
	default n
	help
	    Build/install GNU gccgo compiler ?
```

## toolchain/uClibc/Config.in
```kconfig
choice
	prompt "uClibc version"
	depends on TOOLCHAINOPTS && USE_UCLIBC
	help
	  Select the version of uClibc you wish to use.

	config UCLIBC_USE_VERSION_1_0_21
		bool "uClibc-ng 1.0.21"
		select UCLIBC_VERSION_1_0_21

	config UCLIBC_USE_VERSION_1_0_22
		bool "uClibc-ng 1.0.22"
		select UCLIBC_VERSION_1_0_22

	config UCLIBC_USE_VERSION_1_0_23
		bool "uClibc-ng 1.0.23"
		select UCLIBC_VERSION_1_0_23

	config UCLIBC_USE_VERSION_1_0_24
		bool "uClibc-ng 1.0.24"
		select UCLIBC_VERSION_1_0_24

endchoice

# Debug version.

config UCLIBC_ENABLE_DEBUG
	bool "Build with debug information"
	depends on TOOLCHAINOPTS && USE_UCLIBC
	default n
```
